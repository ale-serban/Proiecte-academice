dolar  DD 009933h, 009933h, 009933h, 009933h, 009933h, 009933h, 009933h, 100000h, 100000h, 009933h, 009933h, 009933h, 009933h, 009933h, 009933h, 009933h
       DD 009933h, 009933h, 009933h, 009933h, 009933h, 009933h, 009933h, 100000h, 100000h, 009933h, 009933h, 009933h, 009933h, 009933h, 009933h, 009933h
       DD 009933h, 009933h, 009933h, 009933h, 009933h, 009933h, 100000h, 100000h, 100000h, 100000h, 009933h, 009933h, 009933h, 009933h, 009933h, 009933h
	   DD 009933h, 009933h, 009933h, 009933h, 009933h, 100000h, 100000h, 100000h, 100000h, 100000h, 100000h, 009933h, 009933h, 009933h, 009933h, 009933h
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	   DD 009933h, 009933h, 009933h, 009933h, 009933h, 009933h, 009933h, 100000h, 100000h, 009933h, 009933h, 009933h, 009933h, 009933h, 009933h, 009933h


	   
